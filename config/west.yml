## config/west.yml
```yaml
manifest:
  remotes:
    - name: zmkfirmware
      url-base: https://github.com/yiancar
    - name: sekigon-gonnoc
      url-base: https://github.com/sekigon-gonnoc
  projects:
    - name: zmk
      remote: zmkfirmware
      revision: 8a346775f131265a8157be718ee4d2e188076851
      import: app/west.yml
    - name: zmk-feature-status-led
      remote: sekigon-gonnoc
      revision: main
  self:
    path: config
```
