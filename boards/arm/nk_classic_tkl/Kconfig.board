## boards/arm/nk_classic_tkl/Kconfig.board
```kconfig
# Copyright (c) 2025 Yiancar
# SPDX-License-Identifier: MIT

config BOARD_NK_CLASSIC_TKL
    bool "nk_classic_tkl"
    depends on SOC_NRF52840_QIAA
```

## boards/arm/nk_classic_tkl/Kconfig.defconfig
```kconfig
# Copyright (c) 2025 Yiancar
# SPDX-License-Identifier: MIT

if BOARD_NK_CLASSIC_TKL

config ZMK_KEYBOARD_NAME
    default "NK Classic TKL"

if USB_DEVICE_STACK

config USB_NRFX
    default y

endif # USB_DEVICE_STACK

config BT_CTLR
    default BT

config ZMK_BLE
    default y

config ZMK_USB
    default y

endif # BOARD_NK_CLASSIC_TKL
```

## boards/novelkeys/nk65_gen2/Kconfig.defconfig
```kconfig
# Copyright (c) 2026 Yiancar
# SPDX-License-Identifier: MIT

if BOARD_NK65_GEN2

config ZMK_KEYBOARD_NAME
    default "NK65 Gen2"

if USB_DEVICE_STACK

config USB_NRFX
    default y

endif # USB_DEVICE_STACK

config ZMK_BLE
    default y

config ZMK_USB
    default y

config ZMK_STATUS_LED
    default y

endif # BOARD_NK65_GEN2
```

## boards/novelkeys/nk65_gen2/Kconfig.nk65_gen2
```kconfig
# Copyright (c) 2026 Yiancar
# SPDX-License-Identifier: Apache-2.0

config BOARD_NK65_GEN2
	select SOC_NRF52833_QIAA
	imply RETAINED_MEM
	imply RETENTION
	imply RETENTION_BOOT_MODE
```

## boards/novelkeys/nk_classic_tkl/Kconfig.nk_classic_tkl
```kconfig
# Copyright (c) 2025 Yiancar
# SPDX-License-Identifier: Apache-2.0

config BOARD_NK_CLASSIC_TKL
	select SOC_NRF52840_QIAA
```

## boards/novelkeys/nk_classic_tkl/nk_classic_tkl_defconfig
```kconfig
# Copyright (c) 2025 Yiancar
# SPDX-License-Identifier: MIT

# Enable MPU
CONFIG_ARM_MPU=y

# enable GPIO
CONFIG_GPIO=y

CONFIG_USE_DT_CODE_PARTITION=y
CONFIG_BUILD_OUTPUT_UF2=y

CONFIG_MPU_ALLOW_FLASH_WRITE=y
CONFIG_NVS=y
CONFIG_SETTINGS_NVS=y
CONFIG_FLASH=y
CONFIG_FLASH_PAGE_LAYOUT=y
CONFIG_FLASH_MAP=y

CONFIG_ZMK_RGB_UNDERGLOW=y
CONFIG_ZMK_RGB_UNDERGLOW_AUTO_OFF_IDLE=y

CONFIG_ZMK_SLEEP=y
CONFIG_ZMK_HID_REPORT_TYPE_NKRO=y
CONFIG_ZMK_HID_INDICATORS=y
CONFIG_ZMK_PM_SOFT_OFF=y

CONFIG_ZMK_USB=y
CONFIG_ZMK_BLE=y

# CONFIG_LOG_BUFFER_SIZE=16384
# CONFIG_ZMK_SETTINGS_RESET_ON_START=y
# CONFIG_LOG=y
CONFIG_LOG_MAX_LEVEL=4
```
